#include "DHT.h"
#include <Adafruit_SSD1306.h>
#include <Adafruit_GFX.h>
#include <RTClib.h>
#include <Wire.h>

#define buzzer D10
#define button D0
#define DHTPIN D3
#define ldr D2

bool state = false; // Initial state set to false
bool lastButtonState = HIGH; // To track the previous button state
DHT dht(DHTPIN, DHT11);
Adafruit_SSD1306 display(128, 64, &Wire, -1);
RTC_DS1307 rtc;

unsigned long pomodoroStartTime;
unsigned long pomodoroDuration = 25 * 60 * 1000; // 25 minutes in milliseconds
bool pomodoroActive = false;
unsigned long buttonPressTime = 0;
bool gameActive = false;  // Toggle for game mode

// Pong game variables
int ballX, ballY;
int ballDirX = 1, ballDirY = 1;
int playerPaddleY = 0, aiPaddleY = 0;
const int paddleHeight = 20;
const int paddleSpeed = 2; // Speed at which paddles move
bool paddleMovingUp = false;

// Animation frames for the clock icon
#define FRAME_DELAY (42)
#define FRAME_WIDTH (32)
#define FRAME_HEIGHT (32)
#define FRAME_COUNT (sizeof(frames) / sizeof(frames[0]))
const byte PROGMEM frames[][128] = {
  {0,0,0,0,0,1,0,0,0,15,224,0,0,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0,0},
  {0,0,0,0,0,1,0,0,0,15,224,0,0,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0,0},
  {0,0,0,0,0,1,128,0,0,7,224,0,0,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0,0},
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  {0,0,0,0,0,1,0,0,0,15,224,0,0,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0,0}
};

const byte PROGMEM framest[][128] = {
  {0,3,192,0,0,6,240,0,0,12,48,0,0,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224,0},
  {0,3,192,0,0,6,240,0,0,12,48,0,0,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224,0},
  {0,3,192,0,0,6,240,0,0,12,48,0,0,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224,0},
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  {0,3,192,0,0,6,240,0,0,12,48,0,0,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224,0}
};

// Function to draw the paddles for Pong
void drawPaddle(int x, int y) {
  display.fillRect(x, y, 2, paddleHeight, WHITE);
}

// Function to draw the ball
void drawBall(int x, int y) {
  display.fillRect(x, y, 4, 4, WHITE);
}

// Function to move the ball in Pong
void moveBall() {
  display.fillRect(ballX, ballY, 4, 4, BLACK);  // Erase previous ball position
  ballX += ballDirX;
  ballY += ballDirY;

  // Ball collision with top and bottom
  if (ballY <= 0 || ballY >= display.height() - 2) ballDirY = -ballDirY;

  // Ball collision with player paddle
  if (ballX <= 2 && ballY >= playerPaddleY && ballY <= playerPaddleY + paddleHeight) {
    ballDirX = -ballDirX;
  }

  // Ball collision with AI paddle
  if (ballX >= display.width() - 4 && ballY >= aiPaddleY && ballY <= aiPaddleY + paddleHeight) {
    ballDirX = -ballDirX;
  }

  // Reset ball position if it goes out
  if (ballX <= 0 || ballX >= display.width()) {
    ballX = display.width() / 2;  // Reset ball to center
    ballY = display.height() / 2;
    ballDirX = -ballDirX;  // Change direction
  }

  drawBall(ballX, ballY);
}

// Function to initialize the Pong game
void setupGame() {
  ballX = display.width() / 2;
  ballY = display.height() / 2;
  playerPaddleY = display.height() / 2 - paddleHeight / 2;
  aiPaddleY = display.height() / 2 - paddleHeight / 2;
}

// AI paddle control for Pong
void aiPaddleControl() {
  if (ballY > aiPaddleY + paddleHeight / 2 && aiPaddleY < display.height() - paddleHeight) {
    aiPaddleY += 2;
  } else if (ballY < aiPaddleY + paddleHeight / 2 && aiPaddleY > 0) {
    aiPaddleY -= 2;
  }
}

// Function to display the Pong game
void playPongGame() {
  // Move player paddle up or down
  if (paddleMovingUp) {
    playerPaddleY -= paddleSpeed;
    if (playerPaddleY <= 0) {
      playerPaddleY = display.height() - paddleHeight;  // Reset to bottom once it reaches the top
    }
  }

  display.clearDisplay();

  // Draw paddles and ball
  drawPaddle(0, playerPaddleY);
  aiPaddleControl();
  drawPaddle(display.width() - 2, aiPaddleY);
  moveBall();

  display.display();
  delay(40);  // Adjust speed of the game
}

void setup() {
  pinMode(button, INPUT_PULLUP);  // Set button pin as input with pull-up resistor
  pinMode(buzzer, OUTPUT);        // Set buzzer pin as output
  
  if (!display.begin(SSD1306_SWITCHCAPVCC, 0x3C)) {
    while (true);
  }

  if (!rtc.begin()) {
    abort();
  }
  if (!rtc.isrunning()) {
    rtc.adjust(DateTime(F(__DATE__), F(__TIME__)));
  }
  dht.begin();
  display.setTextColor(WHITE);
  display.clearDisplay();
}

void drawAnimatedClock(int x, int y) {
  static int frame = 0;
  display.drawBitmap(x, y, frames[frame], FRAME_WIDTH, FRAME_HEIGHT, WHITE);
  frame = (frame + 1) % FRAME_COUNT;
}

void drawTemp(int x, int y) {
  static int frame = 0;
  display.drawBitmap(x, y, framest[frame], FRAME_WIDTH, FRAME_HEIGHT, WHITE);
  frame = (frame + 1) % FRAME_COUNT;
}

void displayOtherInfo() {
  DateTime now = rtc.now();
  float temperature = dht.readTemperature();
  float humidity = dht.readHumidity();
  char buf[] = "DDD, MMM DD YYYY";

  // Get the current hour and determine AM or PM
  int hour = now.hour();
  String period = "AM";
  if (hour >= 12) {
    period = "PM";
    if (hour > 12) hour -= 12;  // Convert to 12-hour format
  } else if (hour == 0) {
    hour = 12;  // Adjust for midnight
  }

  // Convert the hour, minute, and second to strings for formatting
  String currentTime = String(hour) + ":" + (now.minute() < 10 ? "0" : "") + String(now.minute()) + " " + period;

  display.clearDisplay();
  display.setTextSize(1.5);
  display.setTextColor(WHITE);

  drawTemp(95, 5);  

  display.setCursor(0, 10);
  display.print("Temp: ");
  display.setCursor(40, 10);
  display.print(temperature);
  display.setCursor(70, 10);
  display.print((char)247); // Print degree symbol
  display.print("C");

  display.setCursor(0, 25);
  display.print("Humi: ");
  display.setCursor(50, 25);
  display.print(int(humidity));
  display.setCursor(65, 25);
  display.print("%");

  display.setCursor(12, 40);
  display.print(now.toString(buf));

  // Display the formatted time with AM/PM
  display.setCursor(20, 50);
  display.print("Time: ");
  display.setCursor(60, 50);
  display.print(currentTime);

  display.display();
  delay(FRAME_DELAY);  // Small delay to control animation speed
}

void displayPomodoroTimeRemaining() {
  unsigned long elapsedTime = millis() - pomodoroStartTime;
  long remainingTime = pomodoroDuration - elapsedTime; // Ensure this is signed to handle negative times
  
  if (remainingTime <= 0) {
    remainingTime = 0; // Clamp the remaining time to 0 to prevent negative values
    pomodoroActive = false;
    state = false; // Set state to false when time is up
    
    display.clearDisplay();
    display.setTextSize(2);
    display.setCursor(10, 25);
    display.print("Time's up!");
    display.display();
    
    digitalWrite(buzzer, HIGH);
    delay(1000);
    digitalWrite(buzzer, LOW);

    displayOtherInfo();  // Display other info after Pomodoro ends
    return;
  }

  unsigned long minutesRemaining = remainingTime / 60000;
  unsigned long secondsRemaining = (remainingTime % 60000) / 1000;
  
  // Calculate the progress as a percentage
  float progress = (float)elapsedTime / pomodoroDuration; // Progress fraction (0.0 to 1.0)
  int progressBarWidth = 100;  // Width of the progress bar (max is 100 pixels)
  int progressBarFilled = (int)(progress * progressBarWidth); // Calculate the filled portion of the bar
  
  // Display the remaining Pomodoro time and animation
  display.clearDisplay();
  display.setTextSize(1);
  display.setCursor(0, 10);
  display.print("Pomodoro Timer Active");
  display.setTextSize(2);
  display.setCursor(40, 28);
  display.print(minutesRemaining);
  display.print("m ");
  display.print(secondsRemaining);
  display.print("s");
  
  // Draw the progress bar
  display.drawRect(10, 55, progressBarWidth, 5, WHITE); // Draw the outline of the bar
  display.fillRect(10, 55, progressBarFilled, 5, WHITE); // Fill the bar based on progress
  
  // Draw the animated clock icon
  drawAnimatedClock(0, 20);  // Display animation during Pomodoro timer

  display.display();
  delay(FRAME_DELAY);  // Small delay to control animation speed
}

void checkButtonPressForPaddle() {
  bool buttonState = digitalRead(button);
  if (buttonState == HIGH) {
    paddleMovingUp = true;
  } else {
    paddleMovingUp = false;
  }
}

void loop() {
  int ldrValue = digitalRead(ldr);

  // Check if the light is not detected (ldr == 1) to activate the Pong game
  if (ldrValue == 1) {
    if (!gameActive) {
      setupGame();  // Initialize the Pong game
    }
    gameActive = true;
  } else {
    gameActive = false;
  }

  // If the Pong game is active and light is not detected
  if (gameActive) {
    checkButtonPressForPaddle();  // Check if the button is pressed to move paddle
    playPongGame();               // Play the Pong game
  } else {
    // Normal mode - Handle button press to toggle Pomodoro timer
    bool buttonState = digitalRead(button);
    if (buttonState == HIGH && lastButtonState == LOW) {  // Button press detected
      state = !state;  // Toggle the state
      if (state) {
        pomodoroStartTime = millis();  // Start the Pomodoro timer
        pomodoroActive = true;
      } else {
        pomodoroActive = false;
        displayOtherInfo();  // Display other info when not in Pomodoro mode
      }
      delay(50);  // Debounce delay
    }

    lastButtonState = buttonState;

    if (pomodoroActive) {
      displayPomodoroTimeRemaining();  // Display Pomodoro timer
    } else {
      displayOtherInfo();  // Display other info (temperature, humidity, time)
    }
  }
}
